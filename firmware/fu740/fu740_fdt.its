## firmware/fu740/fu740_fdt.its
```
/*
 * Simple U-Boot uImage source file containing a single kernel and FDT blob
 */

/dts-v1/;

/ {
	description = "Simple image with single kernel and FDT blob for fu740";
	#address-cells = <1>;

	images {
		kernel {
			description = "ros for fu740";
			data = /incbin/("ros.bin");
			type = "kernel";
			arch = "riscv";
			os = "linux";
			compression = "none";
			load = <0x80200000>;
			entry = <0x80200000>;
		};
		fdt-1 {
			description = "Flattened Device Tree blob";
			data = /incbin/("./hifive-unmatched-a00.dtb");
			type = "flat_dt";
			arch = "riscv";
			compression = "none";
		};
	};

	configurations {
		default = "conf-1";
		conf-1 {
			description = "Boot kernel with FDT blob for fu740";
			kernel = "kernel";
			fdt = "fdt-1";
		};
	};
};
```
